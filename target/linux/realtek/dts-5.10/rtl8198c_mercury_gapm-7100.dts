// SPDX-License-Identifier: GPL-2.0-or-later OR MIT

#include "rtl8198c.dtsi"

/ {
	compatible = "mercury,gapm-7100", "realtek,rtl8198c-soc";
	model = "F-Secure Sense";

	memory@0 {
		device_type = "memory";
		reg = <0x0 0x8000000>;
	};

};


